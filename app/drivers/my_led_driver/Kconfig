## boards/custom_board_copy/Kconfig.custom_board_copy
```kconfig
# Copyright (c) 2017, Erwin Rol <erwin@erwinrol.com>
# SPDX-License-Identifier: Apache-2.0

config BOARD_CUSTOM_BOARD_COPY
	select SOC_STM32F407XG
```

## boards/custom_board_copy/board.yml
```yaml
board:
  name: custom_board_copy
  full_name: custom_board_copy
  vendor: custom_board_company
  socs:
    - name: stm32f407xx
```

## boards/custom_board_scratch/Kconfig.custom_board_scratch
```kconfig
# Copyright (c) 2017, Erwin Rol <erwin@erwinrol.com>
# SPDX-License-Identifier: Apache-2.0

config BOARD_CUSTOM_BOARD_SCRATCH
	select SOC_STM32F407XG
	select BOARD_LATE_INIT_HOOK
```

## boards/custom_board_scratch/board.yml
```yaml
board:
  name: custom_board_scratch
  full_name: custom_board_scratch
  vendor: custom_board_company
  socs:
    - name: stm32f407xx
```
