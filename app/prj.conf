## CMakeLists.txt
```
cmake_minimum_required(VERSION 3.20.0)

find_package(Zephyr REQUIRED)
project(my_zephyr_app)

target_sources(app PRIVATE src/main.cpp)
add_subdirectory(drivers/my_led_driver)
```

## Kconfig
```
menuconfig LED_SUBSYSTEM
    bool "LED_SUBSYSTEM"
    default y

if LED_SUBSYSTEM

choice
    prompt "LED blink sleep time"
    default BLINK_SLEEP_1000MS

config BLINK_SLEEP_250MS
    bool "250ms fastest"

config BLINK_SLEEP_500MS
    bool "500ms fast"

config BLINK_SLEEP_1000MS
    bool "1s medium"

config BLINK_SLEEP_2000MS
    bool "2s slow"

endchoice

config BLINK_SLEEP_TIME_MS
    int
    default 250 if BLINK_SLEEP_250MS
    default 500 if BLINK_SLEEP_500MS
    default 1000 if BLINK_SLEEP_1000MS
    default 2000 if BLINK_SLEEP_2000MS
    default 0

menuconfig LED_ADVANCED
    bool "Advanced LED settings"
    default n

if LED_ADVANCED

config LED_BRIGHTNESS
    int "LED brightness (0-100)"
    default 100
    range 0 100

config LED_FADE_MS
    int "LED fade duration (ms)"
    default 500
    range 0 5000

menu "Expert settings"

config LED_DEBUG
    bool "Enable LED debugging"
    default n

config LED_CUSTOM_PATTERN
    bool "Custom blink pattern"
    default n

endmenu

endif # LED_ADVANCED

endif # LED_SUBSYSTEM

source "Kconfig.zephyr"
```

## prj.conf
```kconfig
CONFIG_GPIO=y
CONFIG_LOG=y
CONFIG_STM32_ENABLE_DEBUG_SLEEP_STOP=y
CONFIG_MY_LED_DRIVER=y

CONFIG_SHELL=y
```

## app.overlay
```dts
/ {
	my_led_dev0: my_led_dev0 {
		compatible = "my,led_driver";
		status = "okay";
	};
	my_led_dev1: my_led_dev1 {
		compatible = "my,led_driver";
		status = "okay";
	};
};
```

## src/main.cpp
```c
#include <zephyr/drivers/gpio.h>
#include <zephyr/kernel.h>
#include <zephyr/logging/log.h>
#include <zephyr/drivers/sensor.h>

#include "my_led_driver.h"

/* The devicetree node identifier for the "led0" alias. */
#define LED_NODE DT_ALIAS(led0)

static const struct gpio_dt_spec led = GPIO_DT_SPEC_GET(LED_NODE, gpios);

LOG_MODULE_REGISTER(main, LOG_LEVEL_INF);


int main(void)
{
    bool led_state = true;

    if (!gpio_is_ready_dt(&led)) return 0;

    if (gpio_pin_configure_dt(&led, GPIO_OUTPUT_ACTIVE) < 0) return 0;

    const struct device* dev = DEVICE_DT_GET(DT_NODELABEL(my_led_dev0));
    if (!device_is_ready(dev)) {
        return -ENODEV;
    }
    
    struct sensor_value val;

    my_led_driver_set_wait(dev, 10);


    while (1) {

        //if (gpio_pin_toggle_dt(&led) < 0) return 0;
        sensor_channel_get(dev, SENSOR_CHAN_AMBIENT_TEMP, &val);
        
        //led_state = !led_state;
        //LOG_INF("LED state: %s", led_state ? "ON" : "OFF");
        k_msleep(CONFIG_APP_HEARTBEAT_PERIOD_MS);

        sensor_sample_fetch_chan(dev, SENSOR_CHAN_AMBIENT_TEMP);
        k_msleep(CONFIG_APP_HEARTBEAT_PERIOD_MS);
    }
    return 0;
}
```
